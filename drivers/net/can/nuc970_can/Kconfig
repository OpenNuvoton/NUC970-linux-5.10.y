## drivers/net/can/nuc970_can/Kconfig
```kconfig
config NUC970_CAN
	depends on HAS_IOMEM
	tristate "NUC970/N9H30 CAN0/CAN1 devices"
```

## drivers/net/ethernet/nuvoton/Kconfig
```kconfig
#
# Nuvoton network device configuration
#

config NET_VENDOR_NUVOTON
	bool "Nuvoton devices"
	default y
	depends on ARM && ARCH_NUC970
	help
	  If you have a network (Ethernet) card belonging to this class, say Y.

	  Note that the answer to this question doesn't directly affect the
	  kernel: saying N will just cause the configurator to skip all
	  the questions about Nuvoton cards. If you say Y, you will be asked
	  for your specific card in the following questions.

if NET_VENDOR_NUVOTON

config NUC970_ETH0
        tristate "Nuvoton NUC970 Ethernet MAC 0"
        depends on ARM && ARCH_NUC970
        select PHYLIB
        select NET_CORE
        select MII
        help
          Say Y here if you want to use built-in Ethernet MAC 0
          on NUC970 MCU.

config NUC970_ETH1
        tristate "Nuvoton NUC970 Ethernet MAC 1"
        depends on ARM && ARCH_NUC970
        select PHYLIB
        select NET_CORE
        select MII
        help
          Say Y here if you want to use built-in Ethernet MAC 1
          on NUC970 MCU.

endif # NET_VENDOR_NUVOTON
```

## sound/soc/nuc970/Kconfig
```kconfig
# SPDX-License-Identifier: GPL-2.0-only
##
## NUC970/N9H30 series I2S API
##
config SND_SOC_NUC970
	tristate "SoC Audio for NUC970/N9H30 series"
	depends on ARCH_NUC970
	select SND_SOC_GENERIC_DMAENGINE_PCM
	help
	  This option enables support for I2S on the NUC970/N9H30 SoC.

##
## Boards
##
config SND_SOC_NUC970EVB
	tristate "NUC970/N9H30 I2S support for demo board"
	depends on SND_SOC_NUC970
	select SND_SOC_NAU8822
	help
	  Select this option to enable audio (I2S) on the
	  NUC970/N9H30 demo board.
```
